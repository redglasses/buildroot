## package/etcd/Config.in
```kconfig
config BR2_PACKAGE_ETCD
	bool "etcd"
	help
      Distributed reliable key-value store for the most critical data of a distributed system

	  https://coreos.com/etcd/docs/latest/

comment "etcd needs golang"
	depends on BR2_PACKAGE_GOLANG
```

## package/rkt/Config.in
```kconfig
config BR2_PACKAGE_RKT
	bool "rkt"
    depends on BR2_PACKAGE_ACL
    depends on BR2_PACKAGE_CPIO
    depends on BR2_PACKAGE_GOLANG
    depends on BR2_PACKAGE_SQUASHFS
    depends on BR2_PACKAGE_SYSTEMD
	help
      rkt is an App Container runtime for Linux

	  https://coreos.com/rkt/docs/latest/

comment "rkt needs golang"
	depends on BR2_PACKAGE_GOLANG
```
